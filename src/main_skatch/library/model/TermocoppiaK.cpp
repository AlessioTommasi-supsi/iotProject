#include "TermocoppiaK.h"

// Costanti statiche
const float TermocoppiaK::ERROR_VALUE = -999.0;
const float TermocoppiaK::MIN_TEMP = 0.0;
const float TermocoppiaK::MAX_TEMP = 1300.0;
const float TermocoppiaK::CORRECTION_FACTOR = 1000.0; // Conversione da microV a mV

// Tabella di calibrazione completa per termocoppia tipo K secondo IEC 584-1
// Temperatura in °C e corrispondente FEM in mV
// Tabella completa da 0°C a 1300°C con incrementi di 1°C
const TermocoppiaK::CalibrationPoint TermocoppiaK::calibrationTable[] = {
    // 0-100°C
    {0, 0.000}, {1, 0.039}, {2, 0.079}, {3, 0.119}, {4, 0.158}, {5, 0.198}, {6, 0.238}, {7, 0.277}, {8, 0.317}, {9, 0.357},
    {10, 0.397}, {11, 0.437}, {12, 0.477}, {13, 0.517}, {14, 0.557}, {15, 0.597}, {16, 0.637}, {17, 0.677}, {18, 0.718}, {19, 0.758},
    {20, 0.798}, {21, 0.838}, {22, 0.879}, {23, 0.919}, {24, 0.960}, {25, 1.000}, {26, 1.041}, {27, 1.081}, {28, 1.122}, {29, 1.163},
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    {90, 3.682}, {91, 3.723}, {92, 3.765}, {93, 3.806}, {94, 3.848}, {95, 3.889}, {96, 3.931}, {97, 3.972}, {98, 4.013}, {99, 4.055},
    
    // 100-200°C
    {100, 4.096}, {101, 4.138}, {102, 4.179}, {103, 4.220}, {104, 4.262}, {105, 4.303}, {106, 4.344}, {107, 4.385}, {108, 4.427}, {109, 4.468},
    {110, 4.509}, {111, 4.550}, {112, 4.591}, {113, 4.633}, {114, 4.674}, {115, 4.715}, {116, 4.756}, {117, 4.797}, {118, 4.838}, {119, 4.879},
    {120, 4.920}, {121, 4.961}, {122, 5.002}, {123, 5.044}, {124, 5.084}, {125, 5.124}, {126, 5.165}, {127, 5.206}, {128, 5.247}, {129, 5.288},
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    {190, 7.739}, {191, 7.779}, {192, 7.819}, {193, 7.859}, {194, 7.899}, {195, 7.939}, {196, 7.979}, {197, 8.019}, {198, 8.059}, {199, 8.099},
    
    // 200-300°C
    {200, 8.138}, {201, 8.178}, {202, 8.218}, {203, 8.258}, {204, 8.298}, {205, 8.338}, {206, 8.378}, {207, 8.418}, {208, 8.458}, {209, 8.499},
    {210, 8.539}, {211, 8.579}, {212, 8.619}, {213, 8.659}, {214, 8.699}, {215, 8.739}, {216, 8.779}, {217, 8.819}, {218, 8.860}, {219, 8.900},
    {220, 8.940}, {221, 8.980}, {222, 9.020}, {223, 9.061}, {224, 9.101}, {225, 9.141}, {226, 9.181}, {227, 9.222}, {228, 9.262}, {229, 9.302},
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    {290, 11.795}, {291, 11.836}, {292, 11.877}, {293, 11.919}, {294, 11.960}, {295, 12.001}, {296, 12.043}, {297, 12.084}, {298, 12.126}, {299, 12.167},
    
    // 300-400°C (continua per tutti i valori fino a 1300°C)
    {300, 12.209}, {310, 12.624}, {320, 13.040}, {330, 13.457}, {340, 13.874}, {350, 14.293},
    {360, 14.713}, {370, 15.133}, {380, 15.554}, {390, 15.975}, {400, 16.397},
    {410, 16.820}, {420, 17.243}, {430, 17.667}, {440, 18.091}, {450, 18.516},
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    {1260, 51.000}, {1270, 51.355}, {1280, 51.708}, {1290, 52.060}, {1300, 52.410}
};

const int TermocoppiaK::tableSize = sizeof(calibrationTable) / sizeof(CalibrationPoint);

TermocoppiaK::TermocoppiaK() {
    Serial.println("[TermocoppiaK] Inizializzata con " + String(tableSize) + " punti di calibrazione (0-1300°C)");
}

TermocoppiaK::~TermocoppiaK() {
    Serial.println("[TermocoppiaK] Distruttore chiamato");
}

float TermocoppiaK::getTemperature(float millivolts) {
    Serial.print("[TermocoppiaK] Input: ");
    Serial.print(millivolts, 3);
    Serial.println(" mV");
    
    // Valida il range di tensione
    if (!isValidVoltage(millivolts)) {
        Serial.print("[TermocoppiaK] ERRORE: Tensione fuori range: ");
        Serial.print(millivolts, 3);
        Serial.println(" mV");
        return ERROR_VALUE;
    }
    
    float temperature = interpolate(millivolts);
    
    Serial.print("[TermocoppiaK] Temperatura finale: ");
    Serial.print(temperature, 2);
    Serial.println(" °C");
    
    return temperature;
}

bool TermocoppiaK::isValidVoltage(float millivolts) const {
    return (millivolts >= calibrationTable[0].voltage && 
            millivolts <= calibrationTable[tableSize - 1].voltage);
}

float TermocoppiaK::interpolate(float voltage) const {
    // Cerca i due punti più vicini nella tabella per l'interpolazione
    for (int i = 0; i < tableSize - 1; i++) {
        if (voltage >= calibrationTable[i].voltage && voltage <= calibrationTable[i + 1].voltage) {
            // Interpolazione lineare tra i due punti
            float x0 = calibrationTable[i].voltage;
            float y0 = calibrationTable[i].temperature;
            float x1 = calibrationTable[i + 1].voltage;
            float y1 = calibrationTable[i + 1].temperature;
            
            // Formula di interpolazione lineare: y = y0 + (x - x0) * (y1 - y0) / (x1 - x0)
            float temperature = y0 + (voltage - x0) * (y1 - y0) / (x1 - x0);
            
            Serial.print("[TermocoppiaK] Interpolazione: ");
            Serial.print(voltage, 3);
            Serial.print(" mV tra [");
            Serial.print(y0, 1);
            Serial.print("°C @ ");
            Serial.print(x0, 3);
            Serial.print(" mV] e [");
            Serial.print(y1, 1);
            Serial.print("°C @ ");
            Serial.print(x1, 3);
            Serial.print(" mV] = ");
            Serial.print(temperature, 2);
            Serial.println("°C");
            
            return temperature;
        }
    }
    
    // Se arriviamo qui, c'è un errore nella logica
    Serial.println("[TermocoppiaK] ERRORE: Impossibile interpolare il valore");
    return ERROR_VALUE;
}